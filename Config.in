## Config.in
```kconfig
# Add project-specific packages for Buildroot here
#
# If these are non-proprietary, please consider contributing them back to
# Nerves or Buildroot.
#
source "$NERVES_DEFCONFIG_DIR/package/reterminal-dm/Config.in"
source "$NERVES_DEFCONFIG_DIR/package/mipi-dsi/Config.in"
source "$NERVES_DEFCONFIG_DIR/package/ltr30x/Config.in"
source "$NERVES_DEFCONFIG_DIR/package/lis3lv02d/Config.in"
source "$NERVES_DEFCONFIG_DIR/package/bq24179_charger/Config.in"
source "$NERVES_DEFCONFIG_DIR/package/rtc-pcf8563w/Config.in"
```

## package/bq24179_charger/Config.in
```kconfig
config BR2_PACKAGE_BQ24179_CHARGER
	bool "bq24179_charger"
	help
	  bq24179_charger

          https://github.com/Seeed-Studio/seeed-linux-dtoverlays

comment "bq24179_charger needs a Linux kernel to be built"
	depends on !BR2_LINUX_KERNEL
```

## package/lis3lv02d/Config.in
```kconfig
config BR2_PACKAGE_LIS3LV02D
	bool "lis3lv02d"
	help
	  lis3lv02d

          https://github.com/Seeed-Studio/seeed-linux-dtoverlays

comment "lis3lv02d needs a Linux kernel to be built"
	depends on !BR2_LINUX_KERNEL
```

## package/reterminal/Config.in
```kconfig
menuconfig BR2_PACKAGE_RETERMINAL
	bool "reterminal"
	select BR2_PACKAGE_HOST_DTC
	help
	  Reterminal DTS files that may be useful on Nerves systems.
```
